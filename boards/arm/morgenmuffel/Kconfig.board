## boards/arm/morgenmuffel/Kconfig.board
```kconfig
# Morgenmuffel board configuration
#
# Copyright (c) 2019 Marco Peter
#
# SPDX-License-Identifier: Apache-2.0
#

config BOARD_MORGENMUFFEL
	bool "Morgenmuffel Radio Clock Board"
	depends on SOC_STM32F207XX
```

## boards/arm/morgenmuffel/Kconfig.defconfig
```kconfig
# Kconfig - Morgenmuffel board configuration
#
# Copyright (c) 2019 Marco Peter
#
# SPDX-License-Identifier: Apache-2.0
#

if BOARD_MORGENMUFFEL

config BOARD
	default "Morgenmuffel"

config FLASH_HAS_PAGE_LAYOUT
	default y

endif # BOARD_MORGENMUFFEL
```

## boards/arm/morgenmuffel/morgenmuffel_defconfig
```kconfig
# SPDX-License-Identifier: Apache-2.0

CONFIG_BOARD_MORGENMUFFEL=y
CONFIG_SOC_SERIES_STM32F2X=y
CONFIG_SOC_STM32F207XX=y
CONFIG_CORTEX_M_SYSTICK=y
CONFIG_SYS_CLOCK_HW_CYCLES_PER_SEC=120000000

# console
CONFIG_CONSOLE=y
CONFIG_UART_CONSOLE=n
CONFIG_RTT_CONSOLE=y

# enable pinmux
CONFIG_PINMUX=y

# enable GPIO
CONFIG_GPIO=y

# clock configuration
CONFIG_CLOCK_CONTROL=y

CONFIG_SPI=y
CONFIG_SPI_STM32_USE_HW_SS=n

CONFIG_I2C=y
CONFIG_SERIAL=y
CONFIG_UART_INTERRUPT_DRIVEN=y
CONFIG_UART_LINE_CTRL=y

CONFIG_SSD1306=y
CONFIG_LVGL_DISPLAY_DEV_NAME="SSD1306"
CONFIG_LVGL_HOR_RES_MAX=128
CONFIG_LVGL_VER_RES_MAX=64
CONFIG_LVGL_VDB_SIZE=64
CONFIG_LVGL_DPI=59
CONFIG_LVGL_BITS_PER_PIXEL=1
CONFIG_LVGL_COLOR_DEPTH_1=y

CONFIG_NET_L2_ETHERNET=y
CONFIG_ETH_STM32_HAL=y
CONFIG_CLOCK_STM32_MCO2_SRC_HSE=y
CONFIG_CLOCK_STM32_MCO2_DIV=1

CONFIG_NET_OFFLOAD=y
CONFIG_WIFI_ESP=y
CONFIG_WIFI_ESP_AT_VERSION_1_7=y

# Clock configuration for Cube Clock control driver
CONFIG_CLOCK_STM32_HSE_CLOCK=25000000
CONFIG_CLOCK_STM32_SYSCLK_SRC_PLL=y
# use HSE as PLL input
CONFIG_CLOCK_STM32_PLL_SRC_HSE=y
CONFIG_CLOCK_STM32_HSE_BYPASS=n
# produce 120MHz clock at PLL output
CONFIG_CLOCK_STM32_PLL_M_DIVISOR=25
CONFIG_CLOCK_STM32_PLL_N_MULTIPLIER=240
CONFIG_CLOCK_STM32_PLL_P_DIVISOR=2
CONFIG_CLOCK_STM32_PLL_Q_DIVISOR=5
CONFIG_CLOCK_STM32_AHB_PRESCALER=1
CONFIG_CLOCK_STM32_APB1_PRESCALER=4
CONFIG_CLOCK_STM32_APB2_PRESCALER=2
```

## drivers/apds9301/zephyr/Kconfig
```kconfig
# Copyright (c) 2020 Marco Peter
# SPDX-License-Identifier: Apache-2.0

config APDS9301
	bool "APDS9301 illuminance sensor"
	depends on I2C
	help
	  Enable driver for APDS9301 illuminance sensor.
```

## drivers/ms5637/zephyr/Kconfig
```kconfig
# Copyright (c) 2020 Marco Peter
# SPDX-License-Identifier: Apache-2.0

config MS5637
	bool "MS5637 pressure and temperature sensor"
	depends on I2C
	help
	  Enable driver for MS5637 pressure and temperature sensor.
```

## drivers/sht2x/zephyr/Kconfig
```kconfig
# Copyright (c) 2020 Marco Peter
# SPDX-License-Identifier: Apache-2.0

config SHT2X
	bool "SHT2x Humidity and Temperature Sensor"
	depends on I2C
	help
	  Enable driver for SHT2x humidity and temperature sensors
```

## drivers/si4689/zephyr/Kconfig
```kconfig
# Copyright (c) 2020 Marco Peter
# SPDX-License-Identifier: Apache-2.0

config SI4689
	bool "Silicon Labs SI4689 DAB Receiver"
	depends on SPI
	help
	  Enable support for the Silicon Labs SI4689 DAB receiver
```

## drivers/si468x/zephyr/Kconfig
```kconfig
# Copyright (c) 2020 Marco Peter
# SPDX-License-Identifier: Apache-2.0

menuconfig SI468X
	bool "Silicon Labs SI468X FM/DAB/FMHD/AM/AMHD Receiver"
	depends on SPI
	help
	  Enable support for the Silicon Labs SI468x FM/DAB/FMHD/AM/AMHD
	  receivers.

if SI468X

config SI468X_CTSIEN
	bool "Use interrupt line in bootloader"
	help
	  The bootloader toggles the host interrupt line when CTS is available.

choice
	prompt "Clock mode"
	default SI468X_CLK_MODE_CRYSTAL
	help
	  Chose the clock mode to work with.

config SI468X_CLK_MODE_PWRDN
	bool "Oscillator and buffer are powered down."

config SI468X_CLK_MODE_CRYSTAL
	bool "Reference clock generator is in crystal mode."

config SI468X_CLK_MODE_SINGLE_ENDED
	bool "Oscillator is off and circuit acts as single ended buffer."

config SI468X_CLK_MODE_DIFFERENTIAL
	bool "Oscillator is off and circuit acts as differential buffer."

endchoice

config SI468X_CLK_MODE
	int
	default 0 if SI468X_CLK_MODE_PWRDN
	default 1 if SI468X_CLK_MODE_CRYSTAL
	default 2 if SI468X_CLK_MODE_SINGLE_ENDED
	default 3 if SI468X_CLK_MODE_DIFFERENTIAL

config SI468X_TR_SIZE
	int "XOSC TR_SIZE. See refclk spec sheet for more information."
	range 0 15
	default 5

config SI468X_XTALFREQ
	int "XTAL Frequency in Hz."
	default 12288000

if SI468X_CLK_MODE_CRYSTAL

config SI468X_IBIAS
	int "XTAL IBIAS current at startup."
	range 0 127
	default 80

config SI468X_IBIASRUN
	int "XTAL IBIAS current at runtime"
	range 0 127
	default 40

config SI468X_CTUN
	int "CTUN"
	range 0 63
	default 63

endif #SI468X_CLK_MODE_CRYSTAL

config SI468X_FLASH_START_PATCH
	hex "Start address of patch on external flash memory"
	default 0x0

menuconfig SI468X_DAB
	bool "Use DAB Receiver"

if SI468X_DAB

config SI468X_FLASH_START_IMAGE_DAB
	hex "Start address of DAB firmware on external flash memory"
	default 0xB0000

config SI468X_VARACTOR_SLOPE_DAB
	int "Varactor configuration slope in DAB mode"
	default 0
	range -32768 32767

config SI468X_VARACTOR_INTCP_DAB
	int "Varactor configuration intercept in DAB mode"
	default 0
	range 0 65535 

config SI468X_VHFSW_DAB
	bool "Close VHF front end switch in DAB mode"
	default 1

config SI468X_DAB_VALID_RSSI_THRESHOLD
	int "RSSI threshold for valid DAB Seek/Tune in dBuV."
	default 30
	range -128 127

config SI468X_DAB_SERVICE_LIST_SIZE
	int "Size of the internal service list"
	default 100
	help
	  The driver needs an internal list on which service and component can
	  be found on which channel. Each entry requires 4 bytes.

endif #SI468X_DAB

menuconfig SI468X_FMHD
	bool "Use FMHD Receiver"

if SI468X_FMHD

config SI468X_FLASH_START_IMAGE_FM
	hex "Start address of FM firmware on external flash memory"
	default 0x150000

config SI468X_VARACTOR_SLOPE_FMHD
	int "Varactor configuration slope in FMHD mode"
	default -7537
	range -32768 32767

config SI468X_VARACTOR_INTCP_FMHD
	int "Varactor configuration intercept in FMHD mode"
	default 801
	range 0 65535 

config SI468X_VHFSW_FMHD
	bool "Close VHF front end switch in FMHD mode"
	default 0

endif #SI468X_FMHD

menuconfig SI468X_AM
	bool "Use AM Receiver"

if SI468X_AM

config SI468X_FLASH_START_IMAGE_AM
	hex "Start address of AM firmware on external flash memory"
	default 0x10000

endif #SI468X_AM

endif #SI468X
```

## drivers/vs1053/zephyr/Kconfig
```kconfig
# Copyright (c) 2020 Marco Peter
# SPDX-License-Identifier: Apache-2.0

config VS1053
	bool "VLSI VS1053 Codec"
	depends on SPI
	help
	  Enable support for the VLSI VS1053 codec
```
